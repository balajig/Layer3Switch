## Config.in
```kconfig
#
# For a description of the syntax of this configuration file,
# see scripts/kbuild/config-language.txt.
#

mainmenu "Open Switch Solution"

config HAVE_DOT_CONFIG
	bool
	default y
choice
	prompt "Platform"
	default PLATFORM_SIM_LINUX
	help
	  There are 3 Platforms currently we support:
	  - Linux simulation: Simulates Open Switch On Linux.
	  - Linux: Run Linux as a router
	  - Atomthreads: Under Development

config PLATFORM_SIM_LINUX
	bool "Linux simulation"

config SIM_VIRTUAL_LINK_MGR
	bool "Virtual link mgr"
	default y
	depends on PLATFORM_SIM_LINUX
	help
	  Compiles virtual link manager.

config PLATFORM_LINUX
	bool "Linux"

config PLATFORM_ATOMTHREADS
	bool "Atomthreads"

endchoice

menu 'Debugging Options'

config DEBUG
	bool "Build with extra Debugging symbols"
	default n
	help
	  Say Y here if you wish to examine Open Switch Solution internals while
	  running. This increases the size of the binary considerably, and
	  should only be used when doing development. If you are doing
	  development and want to debug it, answer Y.

	  Most people should answer N.

config DEBUG_PESSIMIZE
	bool "Disable compiler optimizations"
	default n
	depends on DEBUG
	help
	  The compiler's optimization of source code can eliminate and reorder
	  code, resulting in an executable that's hard to understand when
	  stepping through it with a debugger. This switches it off, resulting
	  in a much bigger executable that more closely matches the source
	  code.

config WERROR
	bool "Abort compilation on any warning"
	default n
	help
	  Selecting this will add -Werror to gcc command line.

	  Most people should answer N.
endmenu
```
